## main/Kconfig.projbuild
```kconfig
menu "MPU6050 Fall Detection Configuration"

    config MPU_SERIAL_STREAM
        bool "Stream MPU samples to the UART console"
        depends on ESP_CONSOLE_UART
        default n
        help
            Send all six axes at 100 Hz for tools/capture_mpu.py.
            Under Component config > ESP-STDIO, select Custom UART and set
            UART console baud rate to 460800 (minimum 230400). Keep UART0
            and its board pins (ESP32-S3 TX=43, RX=44), then rebuild and flash.
            A separate task and bounded queue keep serial writes out of the
            sampling task. If output cannot keep up, samples are dropped and
            the recorder reports gaps in their sequence numbers.

    config I2C_MASTER_SCL
        int "I2C SCL GPIO Pin"
        default 5
        help
            GPIO number for I2C SCL clock line.

    config I2C_MASTER_SDA
        int "I2C SDA GPIO Pin"
        default 4
        help
            GPIO number for I2C SDA data line.

    config I2C_MASTER_FREQUENCY
        int "I2C Clock Frequency (Hz)"
        default 400000
        help
            I2C clock speed in Hz (100000 for Standard, 400000 for Fast Mode).

    config FALL_RGB_GPIO
        int "Onboard addressable RGB LED GPIO"
        range 0 48
        default 48
        help
            Board-specific: original ESP32-S3-DevKitC-1 uses GPIO48;
            DevKitC-1 v1.1 uses GPIO38. Check your board's schematic.
            N16R8 identifies memory capacity, not the LED pin.

    config FALL_RGB_BRIGHTNESS
        int "Red LED brightness when a fall is detected"
        range 1 255
        default 64

    choice FALL_MODEL_ARENA_LOCATION
        prompt "Model working memory location"
        default FALL_MODEL_ARENA_PSRAM
        help
            Keep PSRAM for the initial INT8 baseline. Compare internal RAM
            after measuring arena usage and available heap on the device.
            Allocation fails visibly rather than silently changing location.

        config FALL_MODEL_ARENA_PSRAM
            bool "PSRAM"

        config FALL_MODEL_ARENA_INTERNAL
            bool "Internal RAM"
    endchoice

    config FALL_MODEL_ARENA_KB
        int "Model working memory (KiB)"
        range 32 4096
        default 256
        help
            Reserved once at boot. Startup validates that the model fits.
            Size includes tensors and kernel scratch buffers. Use the device's
            reported working memory plus headroom; host usage can differ.
            PSRAM placement requires octal PSRAM enabled on the N16R8 board.
            Internal RAM must also leave room for WiFi, queues and tasks.

    config FALL_MODEL_PROFILE
        bool "Log detailed inference timing"
        default n
        help
            Log input quantization/copy, Invoke, total Predict, accumulated
            sample preprocessing time since the previous prediction, queued
            sample age, and result age in microseconds. MQTT time_ms continues
            to report total Predict time. Adds timer calls to the hot path.

    config FALL_SLEEP_BUTTON_GPIO
        int "Sleep/Wake toggle button GPIO"
        range 0 48
        default 0
        help
            GPIO for the momentary push button that toggles sleep/wake mode.
            Default GPIO 0 is the BOOT button on most ESP32-S3-DevKitC boards.
            The pin is configured with an internal pull-up; connect the button
            between this GPIO and GND. Press to toggle between active sensing
            and low-power sleep mode.

endmenu

menu "WiFi and MQTT Configuration"

    config FALL_WIFI_SSID
        string "WiFi SSID"
        default "myssid"
        help
            SSID (network name) to connect to.

    config FALL_WIFI_PASSWORD
        string "WiFi Password"
        default "mypassword"
        help
            WiFi password (WPA2-PSK).

    config FALL_MQTT_BROKER_IP
        string "MQTT Broker IP Address"
        default "192.168.1.100"
        help
            IP address of the machine running the Mosquitto MQTT broker.
            Find it with: hostname -I

    config FALL_MQTT_BROKER_PORT
        int "MQTT Broker Port"
        range 1 65535
        default 1883
        help
            TCP port of the MQTT broker (default 1883).

endmenu
```
